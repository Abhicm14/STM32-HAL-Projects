/** oled.c */
#include "oled.h"
#include <stdio.h>
#include <string.h>

#define OLED_I2C_ADDRESS 0x78
extern I2C_HandleTypeDef hi2c2;

const uint8_t logo_bitmap[1024] = {
    [0 ... 1023] = 0xAA
};

const uint8_t asciiTable[][OLED_EXP_CHAR_LENGTH] = {
			{0x00, 0x00, 0x00, 0x00, 0x00, 0x00}, // SPACE

			{0x00, 0x00, 0x4F, 0x00, 0x00, 0x00}, // !
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			{0x00, 0x00, 0x00, 0x00, 0x00, 0x00}
};

static void OLED_Write(uint8_t value, uint8_t cmd_type)
{
    uint8_t data[2];
    data[0] = cmd_type;
    data[1] = value;
    HAL_I2C_Master_Transmit(&hi2c2, OLED_I2C_ADDRESS, data, 2, HAL_MAX_DELAY);
}

void OLED_Send_Command(uint8_t cmd)
{
    OLED_Write(cmd, 0x00);
}

void OLED_Send_Data(uint8_t data)
{
    OLED_Write(data, 0x40);
}

void OLED_Init(void)
{
    HAL_Delay(100);
    OLED_Send_Command(0xAE);
    OLED_Send_Command(0x20);
    OLED_Send_Command(0x10);
    OLED_Send_Command(0xB0);
    OLED_Send_Command(0xC8);
    OLED_Send_Command(0x00);
    OLED_Send_Command(0x10);
    OLED_Send_Command(0x40);
    OLED_Send_Command(0x81);
    OLED_Send_Command(0xFF);
    OLED_Send_Command(0xA1);
    OLED_Send_Command(0xA6);
    OLED_Send_Command(0xA8);
    OLED_Send_Command(0x3F);
    OLED_Send_Command(0xA4);
    OLED_Send_Command(0xD3);
    OLED_Send_Command(0x00);
    OLED_Send_Command(0xD5);
    OLED_Send_Command(0xF0);
    OLED_Send_Command(0xD9);
    OLED_Send_Command(0x22);
    OLED_Send_Command(0xDA);
    OLED_Send_Command(0x12);
    OLED_Send_Command(0xDB);
    OLED_Send_Command(0x20);
    OLED_Send_Command(0x8D);
    OLED_Send_Command(0x14);
    OLED_Send_Command(0xAF);
    OLED_Clear();
}

void OLED_Set_Cursor(uint8_t x, uint8_t y)
{
    OLED_Send_Command(0xB0 + y);
    OLED_Send_Command(((x & 0xF0) >> 4) | 0x10);
    OLED_Send_Command((x & 0x0F) | 0x01);
}

void OLED_Clear(void)
{
    for (uint8_t page = 0; page < 8; page++) {
        OLED_Set_Cursor(0, page);
        for (uint8_t col = 0; col < 128; col++) {
            OLED_Send_Data(0x00);
        }
    }
}

void OLED_Send_Char(char ch)
{
    if (ch < 32 || ch > 126) ch = '?';
    for (int i = 0; i < OLED_EXP_CHAR_LENGTH; i++) {
        OLED_Send_Data(asciiTable[ch - 32][i]);
    }
}

void OLED_Send_String(const char *str)
{
    while (*str) {
        OLED_Send_Char(*str++);
    }
}

void OLED_Send_Integer(int value)
{
    char buffer[16];
    sprintf(buffer, "%d", value);
    OLED_Send_String(buffer);
}

void OLED_Send_Float(float num, int precision)
{
    char buffer[16];
    char format[10];
    sprintf(format, "%%.%df", precision);
    sprintf(buffer, format, num);
    OLED_Send_String(buffer);
}

void OLED_Draw_Bitmap(const uint8_t *bitmap, uint8_t width, uint8_t height)
{
    uint8_t pages = height / 8;
    for (uint8_t page = 0; page < pages; page++) {
        OLED_Set_Cursor(0, page);
        for (uint8_t col = 0; col < width; col++) {
            OLED_Send_Data(bitmap[page * width + col]);
        }
    }
}
